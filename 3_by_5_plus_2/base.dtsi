// ZMK Core Includes
#include <behaviors.dtsi>
#include <dt-bindings/zmk/keys.h>
#include <dt-bindings/zmk/bt.h>
#include <dt-bindings/zmk/outputs.h>

// Layers
#define BASE    0
#define HEBREW  1
#define SYMBOLS 2
#define KBNAV   3
#define MSNAV   4	
#define BLTH    5

// Meh key
#define MEH LS(LC(LALT))

// Behaviors Constants
#define TAPPING_TERM_MS 280
#define QUICK_TAP_MS 175
#define GLOBAL_QUICK_TAP_MS 150

// Combos Constants
#define COMBO_TERM_DEFAULT 30
#define COMBO_QUICK_TAP_MS 100

#include "behaviors.dtsi"
#include "macros.dtsi"
#include "combos.dtsi"