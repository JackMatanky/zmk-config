/*
 * Copyright (c) 2020 The ZMK Contributors
 *
 * SPDX-License-Identifier: MIT
 */

#include "../base.dtsi"

// Base layers
#include "../layers/1_base_eng.dtsi"
#include "../layers/2_base_heb.dtsi"
#include "../layers/3_symbol.dtsi"
#include "../layers/4_nav_kb.dtsi"
#include "../layers/5_nav_ms.dtsi"
#include "../layers/6_blth.dtsi"