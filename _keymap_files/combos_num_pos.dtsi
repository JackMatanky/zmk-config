/*
* KEY POSITIONS
* 34 Key Matrix
* ╭─────────────────────╮ ╭─────────────────────╮
* │ LT4 LT3 LT2 LT1 LT0 │ │ RT0 RT1 RT2 RT3 RT4 │
* │ LM4 LM3 LM2 LM1 LM0 │ │ RM0 RM1 RM2 RM3 RM4 │
* │ LB4 LB3 LB2 LB1 LB0 │ │ RB0 RB1 RB2 RB3 RB4 │
* ╰───────────╮ LH1 LH0 │ │ RH0 RH1 ╭───────────╯
*             ╰─────────╯ ╰─────────╯ 
*
* ╭────────────────╮ ╭────────────────╮
* │  0  1  2  3  4 │ │  5  6  7  8  9 │
* │ 10 11 12 13 14 │ │ 15 16 17 18 19 │
* │ 20 21 22 23 24 │ │ 25 26 27 28 29 │
* ╰─────────╮ 30 31│ │ 32 33╭─────────╯
*           ╰──────╯ ╰──────╯   
*
* 32 Key Matrix
* ╭────────────────╮ ╭────────────────╮
* │  0  1  2  3  4 │ │  5  6  7  8  9 │
* │ 10 11 12 13 14 │ │ 15 16 17 18 19 │
* ╰──╮ 20 21 22 23 │ │ 24 25 26 27 ╭──╯
*    ╰─────╮ 28 29 │ │ 30 31 ╭─────╯
*          ╰───────╯ ╰───────╯     
* 30 Key Matrix      
* ╭────────────────╮ ╭────────────────╮
* │  0  1  2  3  4 │ │  5  6  7  8  9 │
* │ 10 11 12 13 14 │ │ 15 16 17 18 19 │
* ╰──╮ 20 21 22    │ │    23 24 25 ╭──╯
*    ╰─────╮ 26 27 │ │ 28 29 ╭─────╯
*          ╰───────╯ ╰───────╯    
*/

/*
* Source: https://github.com/caksoylar/zmk-config
*/

#define COMBO(NAME, BINDINGS, KEYPOS, LAYERS, TERM, QUICKTAP, ...) \
    combo_##NAME { \
        timeout-ms = <TERM>; \
        bindings = <BINDINGS>; \
        key-positions = <KEYPOS>; \
        layers = <LAYERS>; \
        require-prior-idle-ms = <QUICKTAP>; \
		__VA_ARGS__ \
    };

/ {
    combos {
        compatible = "zmk,combos";

// Layers
#ifdef 34_KEY
COMBO(english,        &to ENG,        30 33, ENG SYS FUN BLE,     50, 50)
COMBO(heb_to_eng,     &to ENG,        30 33, HEB,                  50, 50)
#endif
#ifdef 32_KEY
COMBO(english,        &to ENG,        28 31, ENG SYS FUN BLE,     50, 50)
COMBO(heb_to_eng,     &to ENG,        28 31, HEB,                  50, 50)
#endif
#ifdef 30_KEY
COMBO(english,        &to ENG,        26 29, ENG SYS FUN BLE,     50, 50)
COMBO(heb_to_eng,     &to ENG,        26 29, HEB,                  50, 50)
#endif

COMBO(hebrew,         &to_heb,        14 15, ENG SYS FUN BLE,     50, 50)
COMBO(blth_l,         &to BLE,        1 2 3, ENG HEB SYS FUN BLE, 50, 50)
COMBO(blth_r,         &to BLE,        6 7 8, ENG HEB SYS FUN BLE, 50, 50)
        
// General
COMBO(capsword,       &caps_word,     4 5,   ENG HEB,              50, 50)
COMBO(alt_tab,        &mm_altb,       0 10,  ENG HEB SYS FUN,      50, 50)
COMBO(escape,         &kp ESCAPE,     4 14,  ENG HEB SYS FUN,      50, 50)
COMBO(bspc_del,       &mm_back_del,   5 15,  ENG HEB SYS FUN,      50, 50)
COMBO(return,         &kp RETURN,     9 19,  ENG HEB SYS FUN,      50, 50)

// Shortcuts
COMBO(copy,           &kp LC(C),      0 1,   ENG HEB SYS FUN,      50, 50)
COMBO(paste,          &mm_paste,      8 9,   ENG HEB SYS FUN,      50, 50)
COMBO(undo,           &kp LC(Z),      0 11,  ENG HEB SYS FUN,      50, 50)
COMBO(redo,           &kp LC(Y),      9 18,  ENG HEB SYS FUN,      50, 50)

// Top Row

// Left
COMBO(lte,            &mm_le,         1 2,   ENG SYS,              50, 50)
COMBO(h_lte,          &mm_hle,        1 2,   ENG SYS,              50, 50)
COMBO(brkt_brce_l,    &kp LBKT,       2 3,   ENG SYS,              50, 50)
COMBO(h_brkt_brce_l,  &kp HE_LBKT,    2 3,   ENG SYS,              50, 50)
COMBO(par_l,          &kp LPAR,       3 4,   ENG SYS,              50, 50)
COMBO(h_par_l,        &kp HE_LPAR,    3 4,   ENG SYS,              50, 50)
// Right
COMBO(par_r,          &kp RPAR,       3 4,   ENG SYS,              50, 50)
COMBO(h_par_r,        &kp HE_RPAR,    3 4,   ENG SYS,              50, 50)
COMBO(brkt_brce_r,    &kp RBKT,       2 3,   ENG SYS,              50, 50)
COMBO(h_brkt_brce_r,  &kp HE_RBKT,    2 3,   ENG SYS,              50, 50)
COMBO(gte,            &mm_ge,         1 2,   ENG SYS,              50, 50)
COMBO(h_gte,          &mm_hge,        1 2,   ENG SYS,              50, 50)

        // Top-Home 
        // Left

        combo_at_sign {
            bindings = <&kp AT_SIGN>;
            key-positions = <1 11>;
            timeout-ms = <50>;
            layers = <0 1 2>;
        };

        combo_hash {
            bindings = <&kp HASH>;
            key-positions = <2 12>;
            timeout-ms = <50>;
            layers = <0 1 2>;
        };

        combo_dollar {
            bindings = <&kp DOLLAR>;
            key-positions = <3 13>;
            timeout-ms = <50>;
            layers = <0 2>;
        };

        combo_shekel {
            bindings = <&kp HE_NEW_SHEQEL>;
            key-positions = <3 13>;
            timeout-ms = <50>;
            layers = <1>;
        };

        // Right

        combo_caret {
            bindings = <&kp CARET>;
            key-positions = <6 16>;
            timeout-ms = <50>;
            layers = <0 1 2>;
        };

        combo_asterisk {
            bindings = <&kp ASTERISK>;
            key-positions = <7 17>;
            timeout-ms = <50>;
            layers = <0 1 2>;
        };

        combo_fslash {
            bindings = <&kp SLASH>;
            key-positions = <8 18>;
            timeout-ms = <50>;
            layers = <0 1 2>;
        };

        // Home-Bottom

        combo_backtick {
            bindings = <&kp GRAVE>;
            key-positions = <11 21>;
            timeout-ms = <50>;
            layers = <0 1 2>;
        };

        combo_underscore {
            bindings = <&kp UNDERSCORE>;
            key-positions = <12 22>;
            timeout-ms = <50>;
            layers = <0 1 2>;
        };

        combo_percent {
            bindings = <&kp PERCENT>;
            key-positions = <13 23>;
            timeout-ms = <50>;
            layers = <0 1 2>;
        };

        combo_bslash {
            bindings = <&kp BACKSLASH>;
            key-positions = <14 24>;
            timeout-ms = <50>;
            layers = <0 1 2>;
        };

        // Left

        combo_pipe {
            bindings = <&kp PIPE>;
            key-positions = <15 25>;
            timeout-ms = <50>;
            layers = <0 1 2>;
        };

        combo_ampersand {
            bindings = <&kp AMPERSAND>;
            key-positions = <16 26>;
            timeout-ms = <50>;
            layers = <0 1 2>;
        };

        combo_plus {
            bindings = <&kp PLUS>;
            key-positions = <17 27>;
            timeout-ms = <50>;
            layers = <0 1 2>;
        };

        combo_hyphen {
            bindings = <&kp MINUS>;
            key-positions = <18 28>;
            timeout-ms = <50>;
            layers = <0 1 2>;
        };

        // Bottom Row (left to right)
        // Left

        combo_tilde {
            bindings = <&kp TILDE>;
            key-positions = <23 24>;
            timeout-ms = <50>;
            layers = <0 1 2>;
        };

        // Right

        combo_equal_unequal {
            bindings = <&mm_eq>;
            key-positions = <25 26>;
            timeout-ms = <50>;
            layers = <0 1 2>;
        };
    };
}

34
combos {
        compatible = "zmk,combos";

        // To Layer

        combo_english {
            bindings = <&to 0>;
            key-positions = <30 33>;
            timeout-ms = <50>;
            layers = <0 2 3 5>;
        };

        combo_hebrew_to_english {
            bindings = <&heb_x>;
            key-positions = <30 33>;
            timeout-ms = <50>;
            layers = <1>;
        };

        combo_hebrew {
            bindings = <&to_heb>;
            key-positions = <14 15>;
            timeout-ms = <50>;
            layers = <0 2 3 5>;
        };

        combo_bluetooth_left {
            bindings = <&to 5>;
            key-positions = <1 2 3>;
            timeout-ms = <50>;
            layers = <0 1 2 3 5>;
        };

        combo_bluetooth_right {
            bindings = <&to 5>;
            key-positions = <6 7 8>;
            timeout-ms = <50>;
            layers = <0 1 2 3 5>;
        };

        // General

        combo_capsword {
            bindings = <&caps_word>;
            key-positions = <4 5>;
            timeout-ms = <50>;
            layers = <0 1>;
        };

        combo_tab {
            bindings = <&mm_altb>;
            key-positions = <0 10>;
            timeout-ms = <50>;
            layers = <0 1 2 3>;
        };

        combo_escape {
            bindings = <&kp ESCAPE>;
            key-positions = <4 14>;
            timeout-ms = <50>;
            layers = <0 1 2 3>;
        };

        combo_backspace_delete {
            bindings = <&mm_bspc_del>;
            key-positions = <5 15>;
            timeout-ms = <50>;
            layers = <0 1 2 3>;
        };

        combo_return {
            bindings = <&kp RETURN>;
            key-positions = <9 19>;
            timeout-ms = <50>;
            layers = <0 1 2 3>;
        };

        // Shortcuts
        //Right

        combo_copy {
            bindings = <&kp LC(C)>;
            key-positions = <0 11>;
            timeout-ms = <50>;
            layers = <0 1 2 3>;
        };

        combo_undo {
            bindings = <&kp LC(Z)>;
            key-positions = <10 21>;
            timeout-ms = <50>;
            layers = <0 1 2 3>;
        };

        // Left

        combo_paste {
            bindings = <&kp LC(V)>;
            key-positions = <9 18>;
            timeout-ms = <50>;
            layers = <0 1 2 3>;
        };

        combo_redo {
            bindings = <&kp LC(Y)>;
            key-positions = <19 28>;
            timeout-ms = <50>;
            layers = <0 1 2 3>;
        };

        // Top Row (Left to Right)
        // Left

        combo_less_than_equal {
            bindings = <&mm_lte>;
            key-positions = <1 2>;
            timeout-ms = <50>;
            layers = <0 2>;
        };

        combo_heb_less_than_equal {
            bindings = <&mm_hlte>;
            key-positions = <1 2>;
            timeout-ms = <50>;
            layers = <1>;
        };

        combo_left_bracket_brace {
            bindings = <&kp LEFT_BRACKET>;
            key-positions = <2 3>;
            timeout-ms = <50>;
            layers = <0 2>;
        };

        combo_heb_left_bracket_brace {
            bindings = <&kp HE_LEFT_BRACKET>;
            key-positions = <2 3>;
            timeout-ms = <50>;
            layers = <1>;
        };

        combo_left_parenthesis {
            bindings = <&kp LEFT_PARENTHESIS>;
            key-positions = <3 4>;
            timeout-ms = <50>;
            layers = <0 2>;
        };

        combo_heb_left_parenthesis {
            bindings = <&kp HE_LEFT_PARENTHESIS>;
            key-positions = <3 4>;
            timeout-ms = <50>;
            layers = <1>;
        };

        // Right

        combo_right_parenthesis {
            bindings = <&kp RIGHT_PARENTHESIS>;
            key-positions = <5 6>;
            timeout-ms = <50>;
            layers = <0 2>;
        };

        combo_heb_right_parenthesis {
            bindings = <&kp HE_RIGHT_PARENTHESIS>;
            key-positions = <5 6>;
            timeout-ms = <50>;
            layers = <1>;
        };

        combo_right_bracket_brace {
            bindings = <&kp RIGHT_BRACKET>;
            key-positions = <6 7>;
            timeout-ms = <50>;
            layers = <0 2>;
        };

        combo_heb_right_bracket_brace {
            bindings = <&kp HE_RIGHT_BRACKET>;
            key-positions = <6 7>;
            timeout-ms = <50>;
            layers = <1>;
        };

        combo_greater_than_equal {
            bindings = <&mm_gte>;
            key-positions = <7 8>;
            timeout-ms = <50>;
            layers = <0 2>;
        };

        combo_heb_greater_than_equal {
            bindings = <&mm_hgte>;
            key-positions = <7 8>;
            timeout-ms = <50>;
            layers = <1>;
        };

        // Top-Home (Left to Right)
        // Left

        combo_at_sign {
            bindings = <&kp AT_SIGN>;
            key-positions = <1 11>;
            timeout-ms = <50>;
            layers = <0 1 2>;
        };

        combo_hash {
            bindings = <&kp HASH>;
            key-positions = <2 12>;
            timeout-ms = <50>;
            layers = <0 1 2>;
        };

        combo_dollar {
            bindings = <&kp DOLLAR>;
            key-positions = <3 13>;
            timeout-ms = <50>;
            layers = <0 2>;
        };

        combo_shekel {
            bindings = <&kp HE_NEW_SHEQEL>;
            key-positions = <3 13>;
            timeout-ms = <50>;
            layers = <1>;
        };

        // Right

        combo_hyphen {
            bindings = <&kp MINUS>;
            key-positions = <6 16>;
            timeout-ms = <50>;
            layers = <0 1 2>;
        };

        combo_asterisk {
            bindings = <&kp ASTERISK>;
            key-positions = <7 17>;
            timeout-ms = <50>;
            layers = <0 1 2>;
        };

        combo_forward_slash {
            bindings = <&kp SLASH>;
            key-positions = <8 18>;
            timeout-ms = <50>;
            layers = <0 1 2>;
        };

        // Home-Bottom

        combo_backtick {
            bindings = <&kp GRAVE>;
            key-positions = <11 21>;
            timeout-ms = <50>;
            layers = <0 1 2>;
        };

        combo_underscore {
            bindings = <&kp UNDERSCORE>;
            key-positions = <12 22>;
            timeout-ms = <50>;
            layers = <0 1 2>;
        };

        combo_percent {
            bindings = <&kp PERCENT>;
            key-positions = <13 23>;
            timeout-ms = <50>;
            layers = <0 1 2>;
        };

        combo_bslash {
            bindings = <&kp BACKSLASH>;
            key-positions = <14 24>;
            timeout-ms = <50>;
            layers = <0 1 2>;
        };

        // Left

        combo_pipe {
            bindings = <&kp PIPE>;
            key-positions = <15 25>;
            timeout-ms = <50>;
            layers = <0 1 2>;
        };

        combo_ampersand {
            bindings = <&kp AMPERSAND>;
            key-positions = <16 26>;
            timeout-ms = <50>;
            layers = <0 1 2>;
        };

        combo_plus {
            bindings = <&kp PLUS>;
            key-positions = <17 27>;
            timeout-ms = <50>;
            layers = <0 1 2>;
        };

        // Bottom Row (left to right)
        // Left

        combo_tilde {
            bindings = <&kp TILDE>;
            key-positions = <23 24>;
            timeout-ms = <50>;
            layers = <0 1 2>;
        };

        // Right

        combo_equal_unequal {
            bindings = <&mm_eq>;
            key-positions = <25 26>;
            timeout-ms = <50>;
            layers = <0 1 2>;
        };
    };

32
combos {
        compatible = "zmk,combos";

        // To Layer

        combo_english {
            bindings = <&to 0>;
            key-positions = <28 31>;
            timeout-ms = <50>;
            layers = <0 2 3 5>;
        };

        combo_hebrew_to_english {
            bindings = <&heb_x>;
            key-positions = <28 31>;
            timeout-ms = <50>;
            layers = <1>;
        };

        combo_hebrew {
            bindings = <&to_heb>;
            key-positions = <14 15>;
            timeout-ms = <50>;
            layers = <0 2 3 5>;
        };

        combo_bluetooth_left {
            bindings = <&to 5>;
            key-positions = <1 2 3>;
            timeout-ms = <50>;
            layers = <0 1 2 3 5>;
        };

        combo_bluetooth_right {
            bindings = <&to 5>;
            key-positions = <6 7 8>;
            timeout-ms = <50>;
            layers = <0 1 2 3 5>;
        };

        // General

        combo_capsword {
            bindings = <&caps_word>;
            key-positions = <4 5>;
            timeout-ms = <50>;
            layers = <0 1>;
        };

        combo_tab {
            bindings = <&mm_altb>;
            key-positions = <0 10>;
            timeout-ms = <50>;
            layers = <0 1 2 3>;
        };

        combo_escape {
            bindings = <&kp ESCAPE>;
            key-positions = <4 14>;
            timeout-ms = <50>;
            layers = <0 1 2 3>;
        };

        combo_backspace_delete {
            bindings = <&mm_bspc_del>;
            key-positions = <5 15>;
            timeout-ms = <50>;
            layers = <0 1 2 3>;
        };

        combo_return {
            bindings = <&kp RETURN>;
            key-positions = <9 19>;
            timeout-ms = <50>;
            layers = <0 1 2 3>;
        };

        // Shortcuts
        //Right

        combo_copy {
            bindings = <&kp LC(C)>;
            key-positions = <0 1>;
            timeout-ms = <50>;
            layers = <0 1 2 3>;
        };

        combo_undo {
            bindings = <&kp LC(Z)>;
            key-positions = <0 11>;
            timeout-ms = <50>;
            layers = <0 1 2 3>;
        };

        // Left

        combo_paste {
            bindings = <&mm_paste>;
            key-positions = <8 9>;
            timeout-ms = <50>;
            layers = <0 1 2 3>;
        };

        combo_redo {
            bindings = <&kp LC(Y)>;
            key-positions = <9 18>;
            timeout-ms = <50>;
            layers = <0 1 2 3>;
        };

        // Top Row (Left to Right)
        // Left

        combo_less_than_equal {
            bindings = <&mm_lte>;
            key-positions = <1 2>;
            timeout-ms = <50>;
            layers = <0 2>;
        };

        combo_heb_less_than_equal {
            bindings = <&mm_hlte>;
            key-positions = <1 2>;
            timeout-ms = <50>;
            layers = <1>;
        };

        combo_left_bracket_brace {
            bindings = <&kp LEFT_BRACKET>;
            key-positions = <2 3>;
            timeout-ms = <50>;
            layers = <0 2>;
        };

        combo_heb_left_bracket_brace {
            bindings = <&kp HE_LEFT_BRACKET>;
            key-positions = <2 3>;
            timeout-ms = <50>;
            layers = <1>;
        };

        combo_left_parenthesis {
            bindings = <&kp LEFT_PARENTHESIS>;
            key-positions = <3 4>;
            timeout-ms = <50>;
            layers = <0 2>;
        };

        combo_heb_left_parenthesis {
            bindings = <&kp HE_LEFT_PARENTHESIS>;
            key-positions = <3 4>;
            timeout-ms = <50>;
            layers = <1>;
        };

        // Right

        combo_right_parenthesis {
            bindings = <&kp RIGHT_PARENTHESIS>;
            key-positions = <5 6>;
            timeout-ms = <50>;
            layers = <0 2>;
        };

        combo_heb_right_parenthesis {
            bindings = <&kp HE_RIGHT_PARENTHESIS>;
            key-positions = <5 6>;
            timeout-ms = <50>;
            layers = <1>;
        };

        combo_right_bracket_brace {
            bindings = <&kp RIGHT_BRACKET>;
            key-positions = <6 7>;
            timeout-ms = <50>;
            layers = <0 2>;
        };

        combo_heb_right_bracket_brace {
            bindings = <&kp HE_RIGHT_BRACKET>;
            key-positions = <6 7>;
            timeout-ms = <50>;
            layers = <1>;
        };

        combo_greater_than_equal {
            bindings = <&mm_gte>;
            key-positions = <7 8>;
            timeout-ms = <50>;
            layers = <0 2>;
        };

        combo_heb_greater_than_equal {
            bindings = <&mm_hgte>;
            key-positions = <7 8>;
            timeout-ms = <50>;
            layers = <1>;
        };

        // Top-Home (Left to Right)
        // Left

        combo_at_sign {
            bindings = <&kp AT_SIGN>;
            key-positions = <1 11>;
            timeout-ms = <50>;
            layers = <0 2>;
        };

        combo_heb_at_sign {
            bindings = <&kp HE_AT_SIGN>;
            key-positions = <1 11>;
            timeout-ms = <50>;
            layers = <1>;
        };

        combo_hash {
            bindings = <&kp HASH>;
            key-positions = <2 12>;
            timeout-ms = <50>;
            layers = <0 2>;
        };

        combo_heb_hash {
            bindings = <&kp HE_HASH>;
            key-positions = <2 12>;
            timeout-ms = <50>;
            layers = <1>;
        };

        combo_dollar {
            bindings = <&kp DOLLAR>;
            key-positions = <3 13>;
            timeout-ms = <50>;
            layers = <0 2>;
        };

        combo_shekel {
            bindings = <&kp HE_NEW_SHEQEL>;
            key-positions = <3 13>;
            timeout-ms = <50>;
            layers = <1>;
        };

        // Right

        combo_hyphen {
            bindings = <&kp MINUS>;
            key-positions = <6 16>;
            timeout-ms = <50>;
            layers = <0 1 2>;
        };

        combo_asterisk {
            bindings = <&kp ASTERISK>;
            key-positions = <7 17>;
            timeout-ms = <50>;
            layers = <0 1 2>;
        };

        combo_forward_slash {
            bindings = <&kp SLASH>;
            key-positions = <8 18>;
            timeout-ms = <50>;
            layers = <0 1 2>;
        };

        // Middle Row (left to right)
        // Left

        combo_equal_unequal {
            bindings = <&mm_eq>;
            key-positions = <13 14>;
            timeout-ms = <50>;
            layers = <0 1 2>;
        };

        // Right

        combo_plus {
            bindings = <&kp PLUS>;
            key-positions = <15 16>;
            timeout-ms = <50>;
            layers = <0 1 2>;
        };

        // Home-Bottom
        // Left

        combo_percent {
            bindings = <&kp PERCENT>;
            key-positions = <21 22>;
            timeout-ms = <50>;
            layers = <0 1 2>;
        };

        combo_backtick {
            bindings = <&kp GRAVE>;
            key-positions = <12 21>;
            timeout-ms = <50>;
            layers = <0 1 2>;
        };

        combo_underscore {
            bindings = <&kp UNDERSCORE>;
            key-positions = <13 22>;
            timeout-ms = <50>;
            layers = <0 1 2>;
        };

        // Right

        combo_ampersand {
            bindings = <&kp AMPERSAND>;
            key-positions = <16 25>;
            timeout-ms = <50>;
            layers = <0 1 2>;
        };

        combo_backslash_pipe {
            bindings = <&kp BACKSLASH>;
            key-positions = <17 26>;
            timeout-ms = <50>;
            layers = <0 1 2>;
        };

        // Bottom Row (left to right)
        // Left

        combo_z {
            bindings = <&kp Z>;
            key-positions = <11 20>;
            timeout-ms = <50>;
            layers = <0>;
        };

        combo_tilde {
            bindings = <&kp TILDE>;
            key-positions = <20 21>;
            timeout-ms = <50>;
            layers = <0 1 2>;
        };

        // Right

        combo_caret {
            bindings = <&kp CARET>;
            key-positions = <25 26>;
            timeout-ms = <50>;
            layers = <0 1 2>;
        };

        combo_question_excl {
            bindings = <&td_qe>;
            key-positions = <18 27>;
            layers = <0 2 3>;
        };

        combo_heb_question_excl {
            bindings = <&td_hqe>;
            key-positions = <18 27>;
            layers = <1>;
        };
    };

30
combos {
        compatible = "zmk,combos";

        // To Layer

        combo_english {
            bindings = <&to 0>;
            key-positions = <26 29>;
            timeout-ms = <50>;
        };

        combo_hebrew_to_english {
            bindings = <&heb_x>;
            key-positions = <26 29>;
            timeout-ms = <50>;
            layers = <1>;
        };

        combo_hebrew {
            bindings = <&to_heb>;
            key-positions = <14 15>;
            timeout-ms = <50>;
            layers = <0 2 3 5>;
        };

        combo_bluetooth_left {
            bindings = <&to 5>;
            key-positions = <1 2 3>;
            timeout-ms = <50>;
            layers = <0 1 2 3 5>;
        };

        combo_bluetooth_right {
            bindings = <&to 5>;
            key-positions = <6 7 8>;
            timeout-ms = <50>;
            layers = <0 1 2 3 5>;
        };

        // General

        combo_capsword {
            bindings = <&caps_word>;
            key-positions = <4 5>;
            timeout-ms = <50>;
            layers = <0 1>;
        };

        combo_tab {
            bindings = <&mm_altb>;
            key-positions = <0 10>;
            timeout-ms = <50>;
            layers = <0 1 2 3>;
        };

        combo_escape {
            bindings = <&kp ESCAPE>;
            key-positions = <4 14>;
            timeout-ms = <50>;
            layers = <0 1 2 3>;
        };

        combo_backspace_delete {
            bindings = <&mm_bspc_del>;
            key-positions = <5 15>;
            timeout-ms = <50>;
            layers = <0 1 2 3>;
        };

        combo_return {
            bindings = <&kp RETURN>;
            key-positions = <19 9>;
            timeout-ms = <50>;
            layers = <0 1 2 3>;
        };

        // Shortcuts

        combo_copy {
            bindings = <&kp LC(C)>;
            key-positions = <0 1>;
            timeout-ms = <50>;
            layers = <0 1 2 3>;
        };

        combo_undo {
            bindings = <&kp LC(Z)>;
            key-positions = <0 11>;
            timeout-ms = <50>;
            layers = <0 1 2 3>;
        };

        combo_paste {
            bindings = <&mm_paste>;
            key-positions = <8 9>;
            timeout-ms = <50>;
            layers = <0 1 2 3>;
        };

        combo_redo {
            bindings = <&kp LC(Y)>;
            key-positions = <9 18>;
            timeout-ms = <50>;
            layers = <0 1 2 3>;
        };

        // Top Row (Left to Right)
        // Left

        combo_less_than_equal {
            bindings = <&mm_lte>;
            key-positions = <1 2>;
            timeout-ms = <50>;
            layers = <0 2>;
        };

        combo_heb_less_than_equal {
            bindings = <&mm_hlte>;
            key-positions = <1 2>;
            timeout-ms = <50>;
            layers = <1>;
        };

        combo_left_bracket_brace {
            bindings = <&kp LEFT_BRACKET>;
            key-positions = <2 3>;
            timeout-ms = <50>;
            layers = <0 2>;
        };

        combo_heb_left_bracket_brace {
            bindings = <&kp HE_LEFT_BRACKET>;
            key-positions = <2 3>;
            timeout-ms = <50>;
            layers = <1>;
        };

        combo_left_parenthesis {
            bindings = <&kp LEFT_PARENTHESIS>;
            key-positions = <3 4>;
            timeout-ms = <50>;
            layers = <0 2>;
        };

        combo_heb_left_parenthesis {
            bindings = <&kp HE_LEFT_PARENTHESIS>;
            key-positions = <3 4>;
            timeout-ms = <50>;
            layers = <1>;
        };

        // Right

        combo_right_parenthesis {
            bindings = <&kp RIGHT_PARENTHESIS>;
            key-positions = <5 6>;
            timeout-ms = <50>;
            layers = <0 2>;
        };

        combo_heb_right_parenthesis {
            bindings = <&kp HE_RIGHT_PARENTHESIS>;
            key-positions = <5 6>;
            timeout-ms = <50>;
            layers = <1>;
        };

        combo_right_bracket_brace {
            bindings = <&kp RIGHT_BRACKET>;
            key-positions = <6 7>;
            timeout-ms = <50>;
            layers = <0 2>;
        };

        combo_heb_right_bracket_brace {
            bindings = <&kp HE_RIGHT_BRACKET>;
            key-positions = <6 7>;
            timeout-ms = <50>;
            layers = <1>;
        };

        combo_greater_than_equal {
            bindings = <&mm_gte>;
            key-positions = <7 8>;
            timeout-ms = <50>;
            layers = <0 2>;
        };

        combo_heb_greater_than_equal {
            bindings = <&mm_hgte>;
            key-positions = <7 8>;
            timeout-ms = <50>;
            layers = <1>;
        };

        // Top-Home Row (Left to Right)
        // Left

        combo_at_sign {
            bindings = <&kp AT_SIGN>;
            key-positions = <1 11>;
            timeout-ms = <50>;
            layers = <0 1 2>;
        };

        combo_hash {
            bindings = <&kp HASH>;
            key-positions = <2 12>;
            timeout-ms = <50>;
            layers = <0 1 2>;
        };

        combo_dollar {
            bindings = <&kp DOLLAR>;
            key-positions = <3 13>;
            timeout-ms = <50>;
            layers = <0 2>;
        };

        combo_shekel {
            bindings = <&kp HE_NEW_SHEQEL>;
            key-positions = <3 13>;
            timeout-ms = <50>;
            layers = <1>;
        };

        // Right

        combo_hyphen {
            bindings = <&kp MINUS>;
            timeout-ms = <50>;
            key-positions = <6 16>;
            layers = <0 1 2>;
        };

        combo_asterisk {
            bindings = <&kp ASTERISK>;
            key-positions = <7 17>;
            timeout-ms = <50>;
            layers = <0 1 2>;
        };

        combo_forward_slash {
            bindings = <&kp SLASH>;
            key-positions = <18 8>;
            timeout-ms = <50>;
            layers = <0 1 2>;
        };

        // Middle Row (left to right)
        // Left

        combo_un_equal {
            bindings = <&mm_eq>;
            key-positions = <13 4>;
            timeout-ms = <50>;
            layers = <0 1 2>;
        };

        // Right

        combo_plus {
            bindings = <&kp PLUS>;
            key-positions = <5 16>;
            timeout-ms = <50>;
            layers = <0 1 2>;
        };

        // Home-Bottom Row (Left to Right)
        // Left

        combo_z {
            bindings = <&kp Z>;
            key-positions = <11 20>;
            timeout-ms = <50>;
            layers = <0>;
        };

        combo_backtick {
            bindings = <&kp GRAVE>;
            key-positions = <12 21>;
            timeout-ms = <50>;
            layers = <0 1 2>;
        };

        combo_underscore {
            bindings = <&kp UNDERSCORE>;
            key-positions = <13 22>;
            timeout-ms = <50>;
            layers = <0 1 2>;
        };

        // Right

        combo_ampersand {
            bindings = <&kp AMPERSAND>;
            key-positions = <16 23>;
            timeout-ms = <50>;
            layers = <0 1 2>;
        };

        combo_backslash_pipe {
            bindings = <&kp BACKSLASH>;
            key-positions = <17 24>;
            timeout-ms = <50>;
            layers = <0 1 2>;
        };

        combo_question_exclamation {
            bindings = <&td_qe>;
            key-positions = <18 25>;
            timeout-ms = <50>;
            layers = <0 2>;
        };

        combo_heb_question_exclamation {
            bindings = <&td_hqe>;
            key-positions = <18 25>;
            timeout-ms = <50>;
            layers = <1>;
        };

        // Bottom row
        // Left

        combo_tilde {
            bindings = <&kp TILDE>;
            key-positions = <20 21>;
            timeout-ms = <50>;
            layers = <0 1 2>;
        };

        combo_percent {
            bindings = <&kp PERCENT>;
            key-positions = <21 22>;
            timeout-ms = <50>;
            layers = <0 1 2>;
        };

        combo_k {
            bindings = <&kp K>;
            key-positions = <14 22>;
            timeout-ms = <50>;
            layers = <0>;
        };

        // Right

        combo_v {
            bindings = <&kp V>;
            key-positions = <15 23>;
            timeout-ms = <50>;
            layers = <0>;
        };

        combo_caret {
            bindings = <&kp CARET>;
            key-positions = <23 24>;
            timeout-ms = <50>;
            layers = <0 1 2>;
        };
    };