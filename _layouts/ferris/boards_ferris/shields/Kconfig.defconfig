## _layouts/ferris/boards_ferris/shields/Kconfig.defconfig
```kconfig
# Copyright (c) 2020 The ZMK Contributors
# SPDX-License-Identifier: MIT

config ZMK_BLE
	default y

config ZMK_USB
	default y

if SHIELD_FERRIS_DONGLE || SHIELD_FERRIS_NORM_LEFT || SHIELD_FERRIS_NORM_RIGHT

config ZMK_KEYBOARD_NAME
	default "Ferris"

endif


if SHIELD_FERRIS_DONGLE_LEFT || SHIELD_FERRIS_DONGLE_RIGHT || SHIELD_FERRIS_NORM_RIGHT

config ZMK_SPLIT
	default y

endif


if SHIELD_FERRIS_DONGLE || SHIELD_FERRIS_NORM_LEFT

config ZMK_SPLIT
	default y

config ZMK_SPLIT_BLE_ROLE_CENTRAL
	default y

endif
```

## _layouts/lazy_ferris/config/boards/shields/lazy_ferris/Kconfig.deconfig
```kconfig
# Copyright (c) 2020 The ZMK Contributors
# SPDX-License-Identifier: MIT

if SHIELD_LAZY_FERRIS_LEFT

config ZMK_KEYBOARD_NAME
    default "Lazy Ferris"

config ZMK_SPLIT_BLE_ROLE_CENTRAL
    default y

endif

if SHIELD_LAZY_FERRIS_LEFT || SHIELD_LAZY_FERRIS_RIGHT

config ZMK_SPLIT
    default y

endif
```

## _layouts/lazy_ferris/config/boards/shields/lazy_ferris/Kconfig.shield
```kconfig
# Copyright (c) 2020 The ZMK Contributors
# SPDX-License-Identifier: MIT

config SHIELD_LAZY_FERRIS_LEFT
	def_bool $(shields_list_contains,lazy_ferris_left)

config SHIELD_LAZY_FERRIS_RIGHT
	def_bool $(shields_list_contains,lazy_ferris_right)
```

## _layouts/lazy_ferris_future_files/round 3/Kconfig.deconfig
```kconfig
# Copyright (c) 2020 The ZMK Contributors
# SPDX-License-Identifier: MIT

config ZMK_BLE
	default y

config ZMK_USB
	default y

if SHIELD_LAZY_FERRIS_DONGLE || SHIELD_LAZY_FERRIS_NORM_LEFT || SHIELD_LAZY_FERRIS_NORM_RIGHT

config ZMK_KEYBOARD_NAME
	default "Lazy Ferris"

endif


if SHIELD_LAZY_FERRIS_DONGLE_LEFT || SHIELD_LAZY_FERRIS_DONGLE_RIGHT || SHIELD_LAZY_FERRIS_NORM_RIGHT

config ZMK_SPLIT
	default y

endif



if SHIELD_LAZY_FERRIS_DONGLE || SHIELD_LAZY_FERRIS_NORM_LEFT

config ZMK_SPLIT
	default y

config ZMK_SPLIT_BLE_ROLE_CENTRAL
	default y

endif
```

## boards/shields/23331_2/Kconfig.defconfig
```kconfig
# Copyright (c) 2020 The ZMK Contributors
# SPDX-License-Identifier: MIT

if SHIELD_2333_2_LEFT

config ZMK_KEYBOARD_NAME
	default "SNAK 2333_2"

config ZMK_SPLIT_ROLE_CENTRAL
	default y

endif # SHIELD_2333_2_LEFT

if SHIELD_2333_2_LEFT || SHIELD_2333_2_RIGHT

config ZMK_SPLIT
	default y

config ZMK_EXT_POWER
	default y

endif # if SHIELD_2333_2_LEFT || SHIELD_2333_2_RIGHT
```

## boards/shields/23331_2/Kconfig.shield
```kconfig
# Copyright (c) 2020 The ZMK Contributors
# SPDX-License-Identifier: MIT

config SHIELD_23331_2_LEFT
	def_bool $(shields_list_contains,23331_2_left)

config SHIELD_23331_2_RIGHT
	def_bool $(shields_list_contains,23331_2_right)
```

## boards/shields/23331_2_mac/Kconfig.defconfig
```kconfig
# Copyright (c) 2020 The ZMK Contributors
# SPDX-License-Identifier: MIT

if SHIELD_23331_2_MAC_LEFT

config ZMK_KEYBOARD_NAME
	default "SNAK 23331_2"

config ZMK_SPLIT_ROLE_CENTRAL
	default y

endif # SHIELD_23331_2_MAC_LEFT

if SHIELD_23331_2_MAC_LEFT || SHIELD_23331_2_MAC_RIGHT

config ZMK_SPLIT
	default y

config ZMK_EXT_POWER
	default y

endif # if SHIELD_23331_2_MAC_LEFT || SHIELD_23331_2_MAC_RIGHT
```

## boards/shields/23331_2_mac/Kconfig.shield
```kconfig
# Copyright (c) 2020 The ZMK Contributors
# SPDX-License-Identifier: MIT

config SHIELD_23331_2_MAC_LEFT
	def_bool $(shields_list_contains,23331_2_mac_left)

config SHIELD_23331_2_MAC_RIGHT
	def_bool $(shields_list_contains,23331_2_mac_right)
```

## boards/shields/23331_2_pc/Kconfig.defconfig
```kconfig
# Copyright (c) 2020 The ZMK Contributors
# SPDX-License-Identifier: MIT

if SHIELD_23331_2_LEFT_PC

config ZMK_KEYBOARD_NAME
	default "SNAK 23331_2_pc"

config ZMK_SPLIT_ROLE_CENTRAL
	default y

endif # SHIELD_23331_2_LEFT_PC

if SHIELD_23331_2_LEFT_PC || SHIELD_23331_2_RIGHT_PC

config ZMK_SPLIT
	default y

config ZMK_EXT_POWER
	default y

endif # if SHIELD_23331_2_LEFT_PC || SHIELD_23331_2_RIGHT_PC
```

## boards/shields/23331_2_pc/Kconfig.shield
```kconfig
# Copyright (c) 2020 The ZMK Contributors
# SPDX-License-Identifier: MIT

config SHIELD_23331_2_LEFT_PC
	def_bool $(shields_list_contains,23331_2_left_pc)

config SHIELD_23331_2_RIGHT_PC
	def_bool $(shields_list_contains,23331_2_right_pc)
```

## boards/shields/23332_2/Kconfig.shield
```kconfig
# Copyright (c) 2020 The ZMK Contributors
# SPDX-License-Identifier: MIT

config SHIELD_23332_2_LEFT
	def_bool $(shields_list_contains,23332_2_left)

config SHIELD_23332_2_RIGHT
	def_bool $(shields_list_contains,23332_2_right)
```

## boards/shields/23332_2_mac/Kconfig.shield
```kconfig
# Copyright (c) 2020 The ZMK Contributors
# SPDX-License-Identifier: MIT

config SHIELD_23332_2_MAC_LEFT
	def_bool $(shields_list_contains,23332_2_mac_left)

config SHIELD_23332_2_MAC_RIGHT
	def_bool $(shields_list_contains,23332_2_mac_right)
```

## boards/shields/23332_2_pc/Kconfig.defconfig
```kconfig
# Copyright (c) 2020 The ZMK Contributors
# SPDX-License-Identifier: MIT

if SHIELD_23332_2_PC_LEFT

config ZMK_KEYBOARD_NAME
	default "SNAK 23332_2"

config ZMK_SPLIT_ROLE_CENTRAL
	default y

endif # SHIELD_23332_2_PC_LEFT

if SHIELD_23332_2_PC_LEFT || SHIELD_23332_2_PC_RIGHT

config ZMK_SPLIT
	default y

config ZMK_EXT_POWER
	default y

endif # if SHIELD_23332_2_PC_LEFT || SHIELD_23332_2_PC_RIGHT
```

## boards/shields/23332_2_pc/Kconfig.shield
```kconfig
# Copyright (c) 2020 The ZMK Contributors
# SPDX-License-Identifier: MIT

config SHIELD_23332_2_PC_LEFT
	def_bool $(shields_list_contains,23332_2_pc_left)

config SHIELD_23332_2_PC_RIGHT
	def_bool $(shields_list_contains,23332_2_pc_right)
```

## boards/shields/2_3x4_2/Kconfig.defconfig
```kconfig
# Copyright (c) 2020 The ZMK Contributors
# SPDX-License-Identifier: MIT

if SHIELD_2_3X4_2_LEFT

config ZMK_KEYBOARD_NAME
	default "SNAK 32"

config ZMK_SPLIT_ROLE_CENTRAL
	default y

endif # SHIELD_2_3X4_2_LEFT

if SHIELD_2_3X4_2_LEFT || SHIELD_2_3X4_2_RIGHT

config ZMK_SPLIT
	default y

config ZMK_EXT_POWER
	default y

endif # if SHIELD_2_3X4_2_LEFT || SHIELD_2_3X4_2_RIGHT
```

## boards/shields/2_3x4_2/Kconfig.shield
```kconfig
# Copyright (c) 2020 The ZMK Contributors
# SPDX-License-Identifier: MIT

config SHIELD_2_3333_2_LEFT
	def_bool $(shields_list_contains,2_3333_2_left)

config SHIELD_2_3333_2_RIGHT
	def_bool $(shields_list_contains,2_3333_2_right)
```

## boards/shields/3x5_2/Kconfig.defconfig
```kconfig
# Copyright (c) 2020 The ZMK Contributors
# SPDX-License-Identifier: MIT

config ZMK_USB
    default y

config ZMK_BLE
    default n

if SHIELD_3X5_2_LEFT

config ZMK_KEYBOARD_NAME
	default "3x5+2"

config ZMK_SPLIT_ROLE_CENTRAL
	default y

endif # SHIELD_3X5_2_LEFT

if SHIELD_3X5_2_LEFT || SHIELD_3X5_2_RIGHT

config ZMK_SPLIT
	default y

config ZMK_EXT_POWER
	default y

endif # if SHIELD_3X5_2_LEFT || SHIELD_3X5_2_RIGHT
```

## config/boards/shields/3x5_2/Kconfig.defconfig
```kconfig
# Copyright (c) 2020 The ZMK Contributors
# SPDX-License-Identifier: MIT

config ZMK_BLE
	default y

config ZMK_USB
	default y

if SHIELD_3X5_2_DONGLE || SHIELD_3X5_2_LEFT || SHIELD_3X5_2_RIGHT

config ZMK_KEYBOARD_NAME
	default "3x5_2"

endif


if SHIELD_3X5_2_DONGLE_LEFT || SHIELD_3X5_2_DONGLE_RIGHT || SHIELD_3X5_2_RIGHT

config ZMK_SPLIT
	default y

endif


if SHIELD_3X5_2_DONGLE || SHIELD_3X5_2_LEFT

config ZMK_SPLIT
	default y

config ZMK_SPLIT_BLE_ROLE_CENTRAL
	default y

endif
```

## config/boards/shields/3x5_2/Kconfig.shield
```kconfig
# Copyright (c) 2020 The ZMK Contributors
# SPDX-License-Identifier: MIT

config SHIELD_3X5_2_LEFT
	def_bool $(shields_list_contains,3x5_2_left)

config SHIELD_3X5_2_RIGHT
	def_bool $(shields_list_contains,3x5_2_right)
```

## config/west.yml
```yaml
# manifest:
#   remotes:
#     - name: zmkfirmware
#       url-base: https://github.com/zmkfirmware
#     - name: caksoylar
#       url-base: https://github.com/caksoylar
#   projects:
#     - name: zmk
#       remote: caksoylar
#       revision: caksoylar/zen-8bit
#       import: app/west.yml
#   self:
#     path: config

manifest:
  remotes:
    - name: urob
      url-base: https://github.com/urob
  projects:
    - name: zmk
      remote: urob
      revision: main
      import: app/west.yml
  self:
    path: config
```

## layouts/corne/config/west.yml
```yaml
manifest:
  remotes:
    - name: JackMatanky
      url-base: https://github.com/JackMatanky
  projects:
    - name: zmk
      remote: JackMatanky
      revision: main
      import: app/west.yml
  self:
    path: config
```

## layouts/ferris/boards_ferris/shields/Kconfig.shield
```kconfig
# Copyright (c) 2020 The ZMK Contributors
# SPDX-License-Identifier: MIT

config SHIELD_FERRIS_DONGLE_LEFT
	def_bool $(shields_list_contains,ferris_dongle_left)

config SHIELD_FERRIS_DONGLE_RIGHT
	def_bool $(shields_list_contains,ferris_dongle_right)

config SHIELD_FERRIS_DONGLE
	def_bool $(shields_list_contains,ferris_dongle)

config SHIELD_FERRIS_NORM_LEFT
	def_bool $(shields_list_contains,ferris_norm_left)

config SHIELD_FERRIS_NORM_RIGHT
	def_bool $(shields_list_contains,ferris_norm_right)
```

## layouts/lazy_ferris_future_files/round 3/Kconfig.shield
```kconfig
# Copyright (c) 2020 The ZMK Contributors
# SPDX-License-Identifier: MIT

config SHIELD_LAZY_FERRIS_DONGLE_LEFT
	def_bool $(shields_list_contains,lazy_ferris_dongle_left)

config SHIELD_LAZY_FERRIS_DONGLE_RIGHT
	def_bool $(shields_list_contains,lazy_ferris_dongle_right)

config SHIELD_LAZY_FERRIS_DONGLE
	def_bool $(shields_list_contains,lazy_ferris_dongle)

config SHIELD_LAZY_FERRIS_NORM_LEFT
	def_bool $(shields_list_contains,lazy_ferris_norm_left)

config SHIELD_LAZY_FERRIS_NORM_RIGHT
	def_bool $(shields_list_contains,lazy_ferris_norm_right)
```
