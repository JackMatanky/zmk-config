/*
* Copyright (c) 2020 Pete Johanson
*
* SPDX-License-Identifier: MIT
*/

#include "23331_2_pc.dtsi"

&kscan0 {
    col-gpios
        // MATRIX
        = <&pro_micro 21 (GPIO_ACTIVE_HIGH)> // PINKY:  COL0
        , <&pro_micro 20 (GPIO_ACTIVE_HIGH)> // RING:   COL1
        , <&pro_micro 19 (GPIO_ACTIVE_HIGH)> // MIDDLE: COL2
        , <&pro_micro 18 (GPIO_ACTIVE_HIGH)> // INDEX:  COL3
        , <&pro_micro 15 (GPIO_ACTIVE_HIGH)> // INNER:  COL4
        // THUMB
        , <&pro_micro 16 (GPIO_ACTIVE_HIGH)> // OUTER:  COL5
        , <&pro_micro 10 (GPIO_ACTIVE_HIGH)> // INNER:  COL6
    ;
};
