/*
* Copyright (c) 2020 Pete Johanson
*
* SPDX-License-Identifier: MIT
*/

#include "2333_2.dtsi"

&default_transform {
    col-offset = <6>;
};

&kscan0 {
    col-gpios
        // THUMB
        = <&pro_micro 10 (GPIO_ACTIVE_HIGH)> // INNER:  COL7
        , <&pro_micro 16 (GPIO_ACTIVE_HIGH)> // OUTER:  COL8
        // MATRIX
        , <&pro_micro 18 (GPIO_ACTIVE_HIGH)> // INDEX:  COL10
        , <&pro_micro 19 (GPIO_ACTIVE_HIGH)> // MIDDLE: COL11
        , <&pro_micro 20 (GPIO_ACTIVE_HIGH)> // RING:   COL12
        , <&pro_micro 21 (GPIO_ACTIVE_HIGH)> // PINKY:  COL13
    ;
};