/*
 * Copyright (c) 2020 The ZMK Contributors
 *
 * SPDX-License-Identifier: MIT
 */

#include <behaviors.dtsi>
#include <dt-bindings/zmk/bt.h>
#include <dt-bindings/zmk/keys.h>
#include <dt-bindings/zmk/outputs.h>
#include <dt-bindings/zmk/mouse.h>

// Hebrew Keymap
#include "hebrew.h"

// Extra Keys
#ifdef WIN
    #include "shortcut_pc.h"
#elifdef MAC
    #include "shortcut_mac.h"
#endif

#define MEH LC(LS(LALT))
#define HYP LC(LS(LA(LGUI)))

// Behaviors Constants
#define long_tap 200
#define short_tap 150

// Combos Constants
// #define default_timeout 50

// Layers
#define ENG     0
#define HEB     1
#define SYM     2
#define NAV     3
#define FUN     4
#define BLE     5
#define ATB     6

/*
* KEY POSITIONS
*         ╭─────────────────────╮ ╭─────────────────────╮
* HIGH:   │ LH4 LH3 LH2 LH1     │ │     RH1 RH2 RH3 RH4 │
* MIDDLE: │ LM4 LM3 LM2 LM1 LM0 │ │ RM0 RM1 RM2 RM3 RM4 │
* LOW:    │     LL3 LL2 LL1     │ │     RL1 RL2 RL3     │
* THUMB:  ╰─────────╮   LT1 LT0 │ │ RT0 RT1 ╭───────────╯
*                   ╰───────────╯ ╰─────────╯
*/

#define KEYS_LH LH4 LH3 LH2 LH1
#define KEYS_LM LM4 LM3 LM2 LM1 LM0
#define KEYS_LL LL3 LL2 LL1
#define KEYS_RH RH4 RH3 RH2 RH1
#define KEYS_RM RM4 RM3 RM2 RM1 RM0
#define KEYS_RL RL3 RL2 RL1

#define KEYS_L KEYS_LH KEYS_LM KEYS_LL
#define KEYS_R KEYS_RH KEYS_RM KEYS_RL

#ifdef WIN
    #include "_macros_pc.dtsi"
    #include "_behaviors_pc.dtsi"
    #include "23331_2_pc_combos.dtsi"
#elifdef MAC
    #include "_macros_mac.dtsi"
    #include "_behaviors_mac.dtsi"
    #include "23331_2_mac_combos.dtsi"
#endif

// #include "_mouse.dtsi"

// Layers
// #include "layer_heb.dtsi"
// #include "layer_sys.dtsi"
// #include "layer_fun.dtsi"
// #include "layer_ble.dtsi"
// #include "layer_atb.dtsi"

// Key Definitions
#ifdef WIN
#   define LM3_ENG &hml LGUI S
#   define LM1_ENG &hml LCTRL H
#   define RM1_ENG &hmr RCTRL N
#   define RM3_ENG &hmr RGUI A
#   define LM3_HEB &hml LGUI HE_DALET
#   define LM1_HEB &hml_h LCTRL 0
#   define RM1_HEB &hmr RCTRL HE_HET
#   define RM3_HEB &hmr RGUI HE_MEM
#   define LM3_SYM &hml_s1 LGUI 0
#   define LM1_SYM &hml_s3 LCTRL 0
#   define RM1_SYM &hmr_s6 RCTRL 0
#   define RM3_SYM &hmr_s8 RGUI 0
#   define LM3_NAV &kp LGUI
#   define LM1_NAV &kp LCTRL
#   define LM3_FUN &hml LGUI F1
#   define LM1_FUN &hml LCTRL F3
#   define RM1_FUN &hmr RCTRL F6
#   define RM3_FUN &hmr RGUI F8
#elifdef MAC
#   define LM3_ENG &hml LCTRL S
#   define LM1_ENG &hml LGUI H
#   define RM1_ENG &hmr RGUI N
#   define RM3_ENG &hmr RCTRL A
#   define LM3_HEB &hml LCTRL HE_DALET
#   define LM1_HEB &hml_h LGUI 0
#   define RM1_HEB &hmr RGUI HE_HET
#   define RM3_HEB &hmr RCTRL HE_MEM
#   define LM3_SYM &hml_s1 LCTRL 0
#   define LM1_SYM &hml_s3 LGUI 0
#   define RM1_SYM &hmr_s6 RGUI 0
#   define RM3_SYM &hmr_s8 RCTRL 0
#   define LM3_NAV &kp LCTRL
#   define LM1_NAV &kp LGUI
#   define LM3_FUN &hml LCTRL F1
#   define LM1_FUN &hml LGUI F3
#   define RM1_FUN &hmr RGUI F6
#   define RM3_FUN &hmr RCTRL F8
#endif

// Behavior Defaults
// Mod-Tap
&mt {
    tapping_term_ms = <200>;
    flavor = "tap-preferred";
};
// Sticky-Key
&sk {
    release-after-ms = <2000>;
    quick-release;
};

&caps_word { continue-list = <BACKSPACE DELETE UNDERSCORE MINUS BSPC DEL N1 N2 N3 N4 N5 N6 N7 N8 N9 N0>; };

/ {
    keymap {
        compatible = "zmk,keymap";
        ENG {
            display-name = "English";
            bindings = <
&kp W   &kp C   &kp G       &kp D                                           &kp L   &kp U       &kp O   &kp Y
&kp R   LM3_ENG &hml LALT T LM1_ENG &kp V                   &kp J           RM1_ENG &hmr RALT E RM3_ENG &kp I
        &kp B   &kp P       &kp F                                           &kp M   &mm_cs      &td_dc
                            &to NAV &khst LSHFT LSHFT       &sht MEH SPACE  &to SYM
            >;
        };
        HEB {
            display-name = "Hebrew";
            bindings = <
&kp HE_QOF  &kp HE_RESH     &kp HE_ALEF         &kp HE_TET                              &kp HE_VAV  &kp HE_FMEM         &mm_hpe &mm_htsdi
&kp HE_SHIN LM3_HEB         &hml LALT HE_GIMEL  LM1_HEB     &kp HE_AYIN     &kp HE_YOD  RM1_HEB     &hmr RALT HE_LAMED  RM3_HEB &mm_hnun
            &kp HE_SAMEKH   &kp HE_BET          &kp HE_HE                               &kp HE_TAV  &mm_hcs             &td_hdc
                                                &trans      &trans          &trans      &trans
            >;
        };
        SYM {
            display-name = "Number-Symbol";
            bindings = <
&kp TILDE   &kp AT      &kp HASH        &mm_usd_nis                         &kp PLUS    &kp ASTRK       &kp SLASH   &kp CARET
&mm_n0n     LM3_SYM     &hml_s2 LALT 0  LM1_SYM         &mm_n4i     &mm_n5j RM1_SYM     &hmr_s7 RALT 0  RM3_SYM     &mm_n9k
            &kp PRCNT   &kp AMPS        &kp UNDERSCORE                      &kp MINUS   &mm_cs          &td_dc
                                        &trans          &trans      &trans  &trans
            >;
        };
        NAV {
            display-name = "Navigation";
            bindings = <
&kp EXIT_APP    &mm_vol_dn_mute &kp C_VOL_UP    &kp C_PP                            &kp HOME    &kp PG_DN   &kp PG_UP   &kp END
&kp BWD_TAB     LM3_NAV         &kp LALT        LM1_NAV     &none       &kp CSCRN   &kp LEFT    &kp DOWN    &kp UP      &kp RIGHT
                &kp PREV_TAB    &kp NEXT_TAB    &kp FWD_TAB                         &kp PSCRN   &mm_cs      &td_dc
                                                &trans      &trans      &trans      &trans
            >;
        };
        FUN {
            display-name = "Function-Shortcut";
            bindings = <
&kp EXIT_APP    &kp F11 &kp F12         &kp F13                      &none      &none           &none   &none
&kp F10         LM3_FUN &hml LALT F2    LM1_FUN &kp F4      &kp F5   RM1_FUN    &hmr RALT F7    RM3_FUN &kp F9
                &none   &none           &none                        &none      &none           &none
                                        &trans  &trans      &trans   &trans
            >;
        };
        BLE {
            display-name = "Bluetooth";
            bindings = <
&bootloader     &out OUT_TOG    &out OUT_USB    &out OUT_BLE                        &out OUT_BLE    &out OUT_USB    &out OUT_TOG    &bootloader
&bt BT_SEL 0    &bt BT_SEL 1    &bt BT_SEL 2    &bt BT_SEL 3    &none       &none   &none           &none           &none           &none
                &bt BT_CLR      &bt BT_PRV      &bt BT_NXT                          &bt BT_NXT      &bt BT_PRV      &none
                                                &none           &none       &none   &none
            >;
        };
        ATB {
            display-name = "Alt-Tab";
            bindings = <
&none   &none   &none   &none                       &none       &none       &none       &none
&none   &none   &none   &none   &none       &none   &kp LEFT    &kp DOWN    &kp UP      &kp RIGHT
        &none   &none   &none                       &none       &none       &none
                        &none   &none       &none   &none
            >;
        };
    };
};
