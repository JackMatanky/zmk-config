/*
 * Copyright (c) 2020 The ZMK Contributors
 *
 * SPDX-License-Identifier: MIT
 */

// Physical Layout
#define INNER_0
// #define INNER_1
// #define INNER_2
#define PINKY_2

// Keymap
// #define COLEMAK
// #define BIRD
#define APT

// Key position files
#include "keypos_26.h"
// #include "keypos_28.h"
// #include "keypos_30.h"
// #include "keypos_32.h"
// #include "keypos_34.h"

// Keymap
#include "base_26-28.dtsi"

// / {
//     keymap {
//         compatible = "zmk,keymap";
//         ENG {
//             display-name = "English";
//             bindings = <
// &kp W   &kp C   &kp G               &kp D                   &kp L           &kp U       &kp O   &kp Y
// &kp R   &kp S   &hml LALT T         &hml LGUI H             &hmr RGUI N     &hmr RALT E &kp A   &kp I
//         &kp B   &kp P               &kp F                   &kp M           &mm_cs      &td_dc
//                 &khst LCTRL LCTRL   &khst LSHFT LSHFT       &sht MEH SPACE  &to SYS
//             >;
//         };
//     };
// };