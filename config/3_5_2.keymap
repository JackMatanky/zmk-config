/*
 * Copyright (c) 2020 The ZMK Contributors
 *
 * SPDX-License-Identifier: MIT
 */

#include "../3x5_2/base.dtsi"

// Base layers
#include "../layouts/3x5_2/layers/1_base_eng.dtsi"
#include "../layouts/3x5_2/layers/2_base_heb.dtsi"
#include "../layouts/3x5_2/layers/3_symbol.dtsi"
#include "../layouts/3x5_2/layers/4_nav_kb.dtsi"
#include "../layouts/3x5_2/layers/5_nav_ms.dtsi"
#include "../layouts/3x5_2/layers/6_blth.dtsi"