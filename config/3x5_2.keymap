/*
 * Copyright (c) 2020 The ZMK Contributors
 *
 * SPDX-License-Identifier: MIT
 */

// Physical Layout
// #define INNER_2
// #define PINKY_2

// Keymap
// #define COLEMAK
#define BIRD

// Key position files
// #include "keypos_30.h"
// #include "keypos_32.h"
#include "keypos_34.h"

// Keymap
#include "base.dtsi"