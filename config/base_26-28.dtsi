/*
 * Copyright (c) 2020 The ZMK Contributors
 *
 * SPDX-License-Identifier: MIT
 */

#include <behaviors.dtsi>
#include <dt-bindings/zmk/bt.h>
#include <dt-bindings/zmk/keys.h>
#include <dt-bindings/zmk/outputs.h>
#include <dt-bindings/zmk/mouse.h>

// Hebrew Keymap
#include "hebrew.h"

// Extra Keys
#include "shortcut_pc.h"
// #include "shortcut_mac.h"

#define MEH LC(LS(LALT))
#define HYP LC(LS(LA(LGUI)))

// Behaviors Constants
#define long_tap 200
#define short_tap 150

// Combos Constants
#define cmb_lng 80
#define cmb_med 50
#define cmb_fst 20

// Layers
#define ENG     0
#define HEB     1
#define SYS     2
#define FUN     3
#define BLE     4
#define ATB     5

/*
* KEY POSITIONS
*         ╭─────────────────────────╮ ╭─────────────────────────╮
* HIGH:   │  LH4  LH3 LH2 LH1 [LH0] │ │ [RH0] RH1 RH2 RH3  RH4  │
* MIDDLE: │  LM4  LM3 LM2 LM1 [LM0] │ │ [RM0] RM1 RM2 RM3  RM4  │
* LOW:    │ [LL4] LL3 LL2 LL1 [LL0] │ │ [RL0] RL1 RL2 RL3 [RL4] │
* THUMB:  ╰─────────────╮ LT1  LT0  │ │  RT0  RT1 ╭─────────────╯
*                       ╰───────────╯ ╰───────────╯
*/

// Key position groups and extra key bindings
#ifdef PINKY_2
// * Dropped bottom pinky keys
#   ifdef INNER_0
// * And dropped inner column keys
#       define KEYS_LH LH4 LH3 LH2 LH1
#       define KEYS_LM LM4 LM3 LM2 LM1
#       define KEYS_LL LL3 LL2 LL1
#       define KEYS_RH RH4 RH3 RH2 RH1
#       define KEYS_RM RM4 RM3 RM2 RM1
#       define KEYS_RL RL3 RL2 RL1
#   elifdef INNER_1
// * And dropped top and bottom inner keys
#       define KEYS_LH LH4 LH3 LH2 LH1
#       define KEYS_LM LM4 LM3 LM2 LM1 LM0
#       define KEYS_LL LL3 LL2 LL1
#       define KEYS_RH RH4 RH3 RH2 RH1
#       define KEYS_RM RM4 RM3 RM2 RM1 RM0
#       define KEYS_RL RL3 RL2 RL1
#   elifdef INNER_2
// * And dropped bottom inner keys
#       define KEYS_LH LH4 LH3 LH2 LH1 LH0
#       define KEYS_LM LM4 LM3 LM2 LM1 LM0
#       define KEYS_LL LL3 LL2 LL1
#       define KEYS_RH RH4 RH3 RH2 RH1 RH0
#       define KEYS_RM RM4 RM3 RM2 RM1 RM0
#       define KEYS_RL RL3 RL2 RL1
#   else
// * Dropped bottom pinky keys
#       define KEYS_LH LH4 LH3 LH2 LH1 LH0
#       define KEYS_LM LM4 LM3 LM2 LM1 LM0
#       define KEYS_LL LL3 LL2 LL1 LL0
#       define KEYS_RH RH4 RH3 RH2 RH1 RH0
#       define KEYS_RM RM4 RM3 RM2 RM1 RM0
#       define KEYS_RL RL3 RL2 RL1 RL0
#   endif
#else
// * Full thirty-four key layout
#   define KEYS_LH LH4 LH3 LH2 LH1 LH0
#   define KEYS_LM LM4 LM3 LM2 LM1 LM0
#   define KEYS_LL LL4 LL3 LL2 LL1 LL0
#   define KEYS_RH RH4 RH3 RH2 RH1 RH0
#   define KEYS_RM RM4 RM3 RM2 RM1 RM0
#   define KEYS_RL RL4 RL3 RL2 RL1 RL0
#endif

# define KEYS_L KEYS_LH KEYS_LM KEYS_LL
# define KEYS_R KEYS_RH KEYS_RM KEYS_RL

#include "_combos.dtsi"
#include "_behaviors.dtsi"
#include "_macros.dtsi"
// #include "_mouse.dtsi"

// Layers
#include "layer_eng.dtsi"
#include "layer_heb.dtsi"
#include "layer_sys.dtsi"
#include "layer_fun.dtsi"
#include "layer_ble.dtsi"
#include "layer_atb.dtsi"

// Behavior Defaults
// Mod-Tap
&mt {
    tapping_term_ms = <200>;
    flavor = "tap-preferred";
};
// Sticky-Key
&sk {
    release-after-ms = <2000>;
    quick-release;
};

&caps_word { continue-list = <BACKSPACE DELETE UNDERSCORE MINUS BSPC DEL N1 N2 N3 N4 N5 N6 N7 N8 N9 N0>; };
