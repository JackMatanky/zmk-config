/*
 * Copyright (c) 2020 The ZMK Contributors
 *
 * SPDX-License-Identifier: MIT
 */

#include "3x5_2.dtsi"

&kscan0 {
    diode-direction = "col2row";
    col-gpios
        = <&pro_micro 21 (GPIO_ACTIVE_HIGH)> // COL0
        , <&pro_micro 20 (GPIO_ACTIVE_HIGH)> // COL1
        , <&pro_micro 19 (GPIO_ACTIVE_HIGH)> // COL2
        , <&pro_micro 18 (GPIO_ACTIVE_HIGH)> // COL3
        , <&pro_micro 15 (GPIO_ACTIVE_HIGH)> // COL4
        , <&pro_micro 16 (GPIO_ACTIVE_HIGH)> // THUMB OUT
        , <&pro_micro 10 (GPIO_ACTIVE_HIGH)> // THUMB IN
    ;
    row-gpios
        = <&pro_micro 6 (GPIO_ACTIVE_HIGH | GPIO_PULL_DOWN)> // ROW0
        , <&pro_micro 7 (GPIO_ACTIVE_HIGH | GPIO_PULL_DOWN)> // ROW1
        , <&pro_micro 8 (GPIO_ACTIVE_HIGH | GPIO_PULL_DOWN)> // ROW2
        , <&pro_micro 9 (GPIO_ACTIVE_HIGH | GPIO_PULL_DOWN)> // ROW3
    ;
};