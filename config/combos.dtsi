/*
* KEY POSITIONS
*         ╭─────────────────────────╮ ╭─────────────────────────╮
* HIGH:   │  LH4  LH3 LH2 LH1  LH0  │ │  RH0  RH1 RH2 RH3  RH4  │
* MIDDLE: │  LM4  LM3 LM2 LM1  LM0  │ │  RM0  RM1 RM2 RM3  RM4  │
* LOW:    │ [LL4] LL3 LL2 LL1 [LL0] │ │ [RL0] RL1 RL2 RL3 [RL4] │
* THUMB:  ╰───────────╮   LT1  LT0  │ │  RT0  RT1 ╭─────────────╯
*                     ╰─────────────╯ ╰───────────╯ 
*
* 34 Key Matrix
* ╭────────────────╮ ╭────────────────╮
* │  0  1  2  3  4 │ │  5  6  7  8  9 │
* │ 10 11 12 13 14 │ │ 15 16 17 18 19 │
* │ 20 21 22 23 24 │ │ 25 26 27 28 29 │
* ╰────────╮ 30 31 │ │ 32 33 ╭────────╯
*          ╰───────╯ ╰───────╯  
*
* 32 Key Matrix
* ╭────────────────╮ ╭────────────────╮
* │  0  1  2  3  4 │ │  5  6  7  8  9 │
* │ 10 11 12 13 14 │ │ 15 16 17 18 19 │
* ╰──╮ 20 21 22 23 │ │ 24 25 26 27 ╭──╯
*    ╰─────╮ 28 29 │ │ 30 31 ╭─────╯
*          ╰───────╯ ╰───────╯     
* 30 Key Matrix      
* ╭────────────────╮ ╭────────────────╮
* │  0  1  2  3  4 │ │  5  6  7  8  9 │
* │ 10 11 12 13 14 │ │ 15 16 17 18 19 │
* ╰──╮ 20 21 22    │ │    23 24 25 ╭──╯
*    ╰─────╮ 26 27 │ │ 28 29 ╭─────╯
*          ╰───────╯ ╰───────╯    
*/

/*
* Source: https://github.com/caksoylar/zmk-config
*/

#define COMBO(NAME, BINDINGS, KEYPOS, LAYERS, TERM, QUICKTAP, ...) \
    combo_##NAME { \
        timeout-ms = <TERM>; \
        bindings = <BINDINGS>; \
        key-positions = <KEYPOS>; \
        layers = <LAYERS>; \
        require-prior-idle-ms = <QUICKTAP>; \
		__VA_ARGS__ \
    };

/ {
    combos {
        compatible = "zmk,combos";

// Layers
COMBO(english,      &to ENG,        LT1 RT1,      ENG SYS FUN BLE,     50, 50);
COMBO(heb_to_eng,   &heb_x,         LT1 RT1,      HEB,                 50, 50);
COMBO(eng_to_heb,   &to_heb,        LM0 RM0,      ENG,                 50, 50);
COMBO(hebrew,       &to HEB,        LM0 RM0,      SYS FUN BLE,         50, 50);
COMBO(blth_l,       &to BLE,        LH3 LH2 LH1,  ENG HEB SYS FUN BLE, 50, 50);
COMBO(blth_r,       &to BLE,        RH1 RH2 RH3,  ENG HEB SYS FUN BLE, 50, 50);
        
// General
COMBO(capsword,     &caps_word,     LH0 RH0,      ENG HEB,              50, 50);
COMBO(alt_tab,      &mm_altb,       LH4 LM4,      ENG HEB SYS FUN,      50, 50);
COMBO(escape,       &kp ESCAPE,     LH0 LM0,      ENG HEB SYS FUN,      50, 50);
COMBO(bspc_del,     &mm_bspc_del,   RH0 RM0,      ENG HEB SYS FUN,      50, 50);
COMBO(return,       &kp RETURN,     RH4 RM4,      ENG HEB SYS FUN,      50, 50);

// Shortcuts
COMBO(copy,         &kp LC(C),      LH4 LH3,      ENG HEB SYS FUN,      50, 50);
COMBO(paste,        &mm_paste,      RH4 RH3,      ENG HEB SYS FUN,      50, 50);
COMBO(undo,         &kp LC(Z),      LH4 LM3,      ENG HEB SYS FUN,      50, 50);
COMBO(redo,         &kp LC(Y),      RH4 RM3,      ENG HEB SYS FUN,      50, 50);

// * Top to Bottom; Left to Right
        
// * Top Row
// * ╭───────┬───────┬───────┬───────┬───────╮   ╭───────┬───────┬───────┬───────┬───────╮
// *       Copy    <= /<    {/[      (                   )      ]/}     >/>=   Paste
// * ╰───────┴───────┴───────┴───────┴───────╯   ╰───────┴───────┴───────┴───────┴───────╯

// Left
COMBO(lte,          &mm_lte,        LH3 LH2,      ENG SYS,              50, 50);
COMBO(h_lte,        &mm_hlte,       LH3 LH2,      HEB,                  50, 50);
COMBO(brkt_brc_l,   &kp LBKT,       LH2 LH1,      ENG SYS,              50, 50);
COMBO(h_brkt_brc_l, &kp HE_LBKT,    LH2 LH1,      HEB,                  50, 50);
COMBO(par_l,        &kp LPAR,       LH1 LH0,      ENG SYS,              50, 50);
COMBO(h_par_l,      &kp HE_LPAR,    LH1 LH0,      HEB,                  50, 50);
// Right
COMBO(par_r,        &kp RPAR,       RH1 RH0,      ENG SYS,              50, 50);
COMBO(h_par_r,      &kp HE_RPAR,    RH1 RH0,      HEB,                  50, 50);
COMBO(brkt_brc_r,   &kp RBKT,       RH2 RH1,      ENG SYS,              50, 50);
COMBO(h_brkt_brc_r, &kp HE_RBKT,    RH2 RH1,      HEB,                  50, 50);
COMBO(gte,          &mm_gte,        RH3 RH2,      ENG SYS,              50, 50);
COMBO(h_gte,        &mm_hgte,       RH3 RH2,      HEB,                  50, 50);

// * Top-Home
// * ╭───────┬───────┬───────┬───────┬───────╮   ╭───────┬───────┬───────┬───────┬───────╮
// *                                                del
// * ├─ tab ─┼─  @  ─┼─  #  ─┼─ ₪/$ ─┼─ esc ─┤   ├─  /  ─┼─  -  ─┼─  *  ─┼─  /  ─┼─ ret ─┤
// *                                               bspc
// * ╰───────┴───────┴───────┴───────┴───────╯   ╰───────┴───────┴───────┴───────┴───────╯

// Left
COMBO(at,           &kp AT,         LH3 LM3,      ENG SYS HEB,          50, 50);
COMBO(hash,         &kp HASH,       LH2 LM2,      ENG SYS HEB,          50, 50);
COMBO(dollar,       &kp DOLLAR,     LH1 LM1,      ENG SYS,              50, 50);
COMBO(h_nis,        &kp HE_NIS,     LH1 LM1,      HEB,                  50, 50);
// Right
COMBO(hyphen,       &kp MINUS,      RH1 RM1,      ENG SYS HEB,          50, 50);
COMBO(asterisk,     &kp ASTRK,      RH2 RM2,      ENG SYS HEB,          50, 50);
COMBO(fslash,       &kp FSLH,       RH3 RM3,      ENG SYS,              50, 50);
COMBO(h_fslash,     &kp HE_FSLH,    RH3 RM3,      HEB,                  50, 50);

// * Middle Row
// * ╭───────┬───────┬───────┬───────┬───────╮   ╭───────┬───────┬───────┬───────┬───────╮
// *                              != / =                 +
// * ╰───────┴───────┴───────┴───────┴───────╯   ╰───────┴───────┴───────┴───────┴───────╯

#ifdef INNER_2
// Left
COMBO(un_equal,     &mm_eq,         LM1 LH0,      ENG SYS HEB,          50, 50);
// Right
COMBO(plus,         &kp PLUS,       RM1 RH0,      ENG SYS HEB,          50, 50);
#else
// Left
COMBO(un_equal,     &mm_eq,         LM1 LM0,      ENG SYS HEB,          50, 50);
// Right
COMBO(plus,         &kp PLUS,       RM1 RM0,      ENG SYS HEB,          50, 50);
#endif

// * Home-Bottom
// * ╭───────┬───────┬───────┬───────┬───────╮   ╭───────┬───────┬───────┬───────┬───────╮
// *                                                                       [???]
 //* ├───────┼ [ז/Z] ┼─  %  ─┼─  &  ─┼───────┤   ├───────┼─  _  ─┼─  `  ─┼ [!/?] ┼───────┤
// * 
// * ╰───────┴───────┴───────┴───────┴───────╯   ╰───────┴───────┴───────┴───────┴───────╯

// Left
COMBO(percent,      &kp PRCNT,      LM2 LL2,      ENG SYS HEB,          50, 50);
COMBO(ampersand,    &kp AMPS,       LM1 LL1,      ENG SYS HEB,          50, 50);
// Right
COMBO(underscore,   &kp UNDER,      RM1 RL1,      ENG SYS HEB,          50, 50);
COMBO(backtick,     &kp GRAVE,      RM2 RL2,      ENG HEB SYS,          50, 50);

// Home-Bottom Ring Column
#ifdef PINKY_2
// Left
COMBO(z,            &kp Z,          LM3 LL3,      ENG SYS,              50, 50);
COMBO(zayin,        &kp HE_ZAYIN,   LM3 LL3,      HEB,                  50, 50);
// Right
COMBO(ques_excl,    &td_qe,         RM3 RL3,      ENG SYS HEB,          50, 50);
#endif

// * Bottom Row
// * ╭───────┬───────┬───────┬───────┬───────╮   ╭───────┬───────┬───────┬───────┬───────╮
// *                 ~     caret                                 \      pipe
// * ╰───────┴───────┴───────┴───────┴───────╯   ╰───────┴───────┴───────┴───────┴───────╯

// Left
COMBO(tilde,        &kp TILDE,      LL3 LL2,      ENG SYS HEB,           50, 50);
COMBO(caret,        &kp CARET,      LL2 LL1,      ENG SYS HEB,           50, 50);
// Right
COMBO(bslash,       &kp BSLH,       RL2 RL1,      ENG SYS HEB,           50, 50);
COMBO(pipe,         &kp PIPE,       RL3 RL2,      ENG SYS HEB,           50, 50);
    };
}