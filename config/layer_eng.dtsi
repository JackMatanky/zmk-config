/ {
    keymap {
        compatible = "zmk,keymap";
#ifdef INNER_0
        ENG {
            display-name = "English";
            bindings = <
&kp W   &kp C   &kp G               &kp D                   &kp L           &kp U       &kp O   &kp Y
&kp R   &kp S   &hml LALT T         &hml LGUI H             &hmr RGUI N     &hmr RALT E &kp A   &kp I
        &kp B   &kp P               &kp F                   &kp M           &mm_cs      &td_dc
                &khst LCTRL LCTRL   &khst LSHFT LSHFT       &sht MEH SPACE  &mm_sys_fn
            >;
        };
#else
        ENG {
            display-name = "English";
            bindings = <
&kp W   &kp C   &kp G       &kp D                                                       &kp L       &kp U       &kp O   &kp Y
&kp R   &kp S   &hml LALT T &hml LGUI H         &kp V                   &kp J           &hmr RGUI N &hmr RALT E &kp A   &kp I
        &kp B   &kp P       &kp F                                                       &kp M       &mm_cs      &td_dc
                            &khst LCTRL LCTRL   &khst LSHFT LSHFT       &sht MEH SPACE  &mm_sys_fn
            >;
        };
#endif
    };
};