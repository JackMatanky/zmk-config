// Key position groups and extra key bindings
#ifdef PINKY_2
// * Dropped bottom pinky keys
#   define LL4_HEB
#   define RL4_HEB
#   ifdef INNER_0
// * And dropped inner column keys - 2333_2
#       define LM1_HEB &hml_h LGUI 0
#       define LH0_HEB
#       define LM0_HEB
#       define LL0_HEB
#       define RH0_HEB
#       define RM0_HEB
#       define RL0_HEB
#       define RH1_HEB &kp HE_VAV
#       define RM1_HEB &hmr RGUI HE_YOD
#       define RH2_HEB &mm_hnun
#       define RM2_HEB &hmr RALT HE_HET
#       define RH3_HEB &mm_hpe
#       define RM3_HEB &kp HE_MEM
#       define RH4_HEB &mm_htsdi
#       define RM4_HEB &kp HE_FMEM
#   elifdef INNER_1
// * And dropped top and bottom inner keys - 23331_2
#       define LM1_HEB &hml_h LGUI 0
#       define LH0_HEB
#       define LM0_HEB &kp HE_AYIN
#       define LL0_HEB
#       define RH0_HEB
#       define RM0_HEB &kp HE_YOD
#       define RL0_HEB
#       define RH1_HEB &kp HE_VAV
#       define RM1_HEB &hmr RGUI HE_HET
#       define RH2_HEB &mm_hnun
#       define RM2_HEB &hmr RALT HE_LAMED
#       define RH3_HEB &mm_hpe
#       define RM3_HEB &kp HE_MEM
#       define RH4_HEB &mm_htsdi
#       define RM4_HEB &kp HE_FMEM
#   elifdef INNER_2
// * And dropped bottom inner keys - 23332_2
#       define LM1_HEB &hml LGUI HE_KAF
#       define LH0_HEB &kp HE_VAV
#       define LM0_HEB &kp HE_AYIN
#       define LL0_HEB
#       define RH0_HEB &kp HE_YOD
#       define RM0_HEB &kp HE_MEM
#       define RL0_HEB
#       define RH1_HEB &mm_hnun
#       define RM1_HEB &hmr RGUI HE_HET
#       define RH2_HEB &kp HE_FMEM
#       define RM2_HEB &hmr RALT HE_LAMED
#       ifdef BIRD
#           define RH3_HEB &mm_hpe
#           define RM3_HEB &kp HE_MEM
#           define RH4_HEB &mm_htsdi
#           define RM4_HEB &mm_hpe
#       else
#           define RH3_HEB &kp HE_PE
#           define RM3_HEB &kp HE_FKAF
#           define RH4_HEB &mm_htsdi
#           define RM4_HEB &kp HE_FPE
#   else
// * Dropped bottom pinky keys - 23333_2
#       define LM1_HEB &hml LGUI HE_KAF
#       define LH0_HEB &kp HE_VAV
#       define LM0_HEB &kp HE_AYIN
#       define LL0_HEB &kp HE_NUN
#       define RH0_HEB &kp HE_FNUN
#       define RM0_HEB &kp HE_YOD
#       define RL0_HEB &kp HE_MEM
#       define RH1_HEB &kp HE_FMEM
#       define RM1_HEB &hmr RGUI HE_HET
#       define RH2_HEB &kp HE_PE
#       define RM2_HEB &hmr RALT HE_LAMED
#       define RH3_HEB &mm_htsdi
#       define RM3_HEB &kp HE_FKAF
#       define RH4_HEB &td_hstq
#       define RM4_HEB &kp HE_FPE
#   endif
#else
// * Full thirty-four key layout
#   define LL4_HEB &kp HE_ZAYIN
#   define LM1_HEB &hml LGUI HE_KAF
#   define LH0_HEB &kp HE_VAV
#   define LM0_HEB &kp HE_AYIN
#   define LL0_HEB &kp HE_NUN
#   define RH0_HEB &kp HE_FNUN
#   define RM0_HEB &kp HE_YOD
#   define RL0_HEB &kp HE_MEM
#   define RH1_HEB &kp HE_FMEM
#   define RM1_HEB &hmr RGUI HE_HET
#   define RH2_HEB &kp HE_PE
#   define RM2_HEB &hmr RALT HE_LAMED
#   define RH3_HEB &mm_htsdi
#   define RM3_HEB &kp HE_FKAF
#   define RH4_HEB &td_hstq
#   define RM4_HEB &kp HE_FPE
#   define RL4_HEB &td_qe
#endif

/ {
    keymap {
        compatible = "zmk,keymap";
        HEB {
            display-name = "Hebrew";
            bindings = <
&kp HE_QOF  &kp HE_RESH     &kp HE_ALEF         &kp HE_TET      LH0_HEB     RH0_HEB RH1_HEB     RH2_HEB RH3_HEB RH4_HEB
&kp HE_SHIN &kp HE_DALET    &hml LALT HE_GIMEL  LM1_HEB         LM0_HEB     RM0_HEB RM1_HEB     RM2_HEB RM3_HEB RM4_HEB
LL4_HEB     &kp HE_SAMEKH   &kp HE_BET          &kp HE_HE       LL0_HEB     RL0_HEB &kp HE_TAV  &mm_hcs &td_hdc RL4_HEB
                                                &trans          &trans      &trans  &trans
            >;
        };
    };
};