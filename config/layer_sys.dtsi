// Key position groups and extra key bindings
#ifdef PINKY_2
// * Dropped bottom pinky keys
#   define LL4_SYS
#   define RL4_SYS
#   ifdef INNER_0
// * And dropped inner column keys - 2333_2
#       define LH0_SYS
#       define LM0_SYS
#       define LL0_SYS
#       define RH0_SYS
#       define RM0_SYS
#       define RL0_SYS
#   elifdef INNER_1
// * And dropped top and bottom inner keys - 23331_2
#       define LH0_SYS
#       define LM0_SYS &mm_msclk
#       define LL0_SYS
#       define RH0_SYS
#       define RM0_SYS &kp RGUI
#       define RL0_SYS
#   elifdef INNER_2
// * And dropped bottom inner keys - 23332_2
#       define LH0_SYS &mkp LCLK
#       define LM0_SYS &none
#       define LL0_SYS
#       define RH0_SYS &mkp RCLK
#       define RM0_SYS &kp RGUI
#       define RL0_SYS
#   else
// * Dropped bottom pinky keys - 23333_2
#       define LH0_SYS &mkp LCLK
#       define LM0_SYS &none
#       define LL0_SYS &none
#       define RH0_SYS &mkp RCLK
#       define RM0_SYS &kp RGUI
#       define RL0_SYS &none
#   endif
#else
// * Full thirty-four key layout
#   define LL4_SYS &none
#   define LH0_SYS &mkp LCLK
#   define LM0_SYS &none
#   define LL0_SYS &none
#   define RH0_SYS &mkp RCLK
#   define RM0_SYS &kp RGUI
#   define RL0_SYS &none
#   define RL4_SYS &none
#endif

#define LM2_SYS &hml_s5 LALT 0
#define LM1_SYS &hml_s6 LGUI 0

/ {
    keymap {
        compatible = "zmk,keymap";
#if defined PINKY_2 && defined INNER_2 && defined APT
        SYS {
            display-name = "Number-System";
            bindings = <
&none   &mm_n7x  &mm_n8y    &mm_n9z LH0_SYS         RH0_SYS &kp HOME    &kp PG_DN   &kp PG_UP   &kp END
&kp N0  &mm_n4i  LM2_SYS    LM1_SYS LM0_SYS         RM0_SYS &kp LEFT    &kp DOWN    &kp UP      &kp RIGHT
LL4_SYS &mm_n1a  &mm_n2b    &mm_n3c LL0_SYS         RL0_SYS &kp RALT    &mm_cs      &td_dc      RL4_SYS
                            &trans  &trans          &trans  &trans
            >;
        };
#else
        SYS {
            display-name = "Number-System";
            bindings = <
&none   &kp N7  &kp N8          &kp N9          LH0_SYS     RH0_SYS &kp HOME  &kp UP    &kp END    &kp PG_UP
&kp N0  &kp N4  &hml LALT N5    &hml LGUI N6    LM0_SYS     RM0_SYS &kp LEFT  &kp DOWN  &kp RIGHT  &kp PG_DN
LL4_SYS &kp N1  &kp N2          &kp N3          LL0_SYS     RL0_SYS &kp RALT  &mm_cs    &td_dc     RL4_SYS
                                &trans          &trans      &trans  &trans
            >;
        };
#endif
    };
};
