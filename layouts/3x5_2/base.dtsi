// ZMK Core Includes
#include <behaviors.dtsi>
#include <dt-bindings/zmk/keys.h>
#include <dt-bindings/zmk/bt.h>
#include <dt-bindings/zmk/outputs.h>

// Layers
#define ENG    0
#define HEB    1
#define SYM    2
#define KBNV   3
#define MSNV   4	
#define BLTH   5

// Behaviors Constants
#define long_tap 200
#define short_tap 150

// Combos Constants
#define default_timeout 50

// Board Specific Includes
#include "../3x5_2/behaviors.dtsi"
#include "../3x5_2/combos.dtsi"

// Keymap Includes
#include "../../keys/shortcut.h"
#include "../../keys/mod.h"
#include "../../keys/hebrew.h"